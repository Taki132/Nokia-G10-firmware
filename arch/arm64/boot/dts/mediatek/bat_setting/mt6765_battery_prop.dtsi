// SPDX-License-Identifier: GPL-2.0
/*
 * Copyright (c) 2019 MediaTek Inc.
 * Author: Wy Chuang<wy.chuang@mediatek.com>
 *
 */

&mtk_gauge {
	DIFFERENCE_FULLOCV_ITH = <(250)>;
	/* Charging termination current */
	SHUTDOWN_1_TIME = <(30)>;
	/* If ui_soc shows 1% more than X minites, system will shutdown */
	KEEP_100_PERCENT = <(1)>;
	R_FG_VALUE = <(10)>;
	/* R_sense resistance */
//+Bug584789, lishuwen@WT,20201010, modify, modify second battery capacity and config para
	EMBEDDED_SEL = <(1)>;
//-Bug584789, lishuwen@WT,20201010, modify, modify second battery capacity and config para
	/* Configures whether using embedded battery or not */
	PMIC_SHUTDOWN_CURRENT = <(20)>;
	/* System shutdown current */
	FG_METER_RESISTANCE = <(75)>;
	/* The resistance of PCB */
	CAR_TUNE_VALUE = <(100)>;
	/* Tune value for current measurement */
	PMIC_MIN_VOL = <(33500)>;
	/* vboot voltage for gauge 0%*/
	POWERON_SYSTEM_IBOOT = <(500)>;
	/* power on system iboot */
	SHUTDOWN_GAUGE0_VOLTAGE = <(34000)>;
	/* shutdown gauge 0% voltage */
	TEMPERATURE_T0 = <(50)>;
	/* Battery temperature T0 */
	TEMPERATURE_T1 = <(25)>;
	/* Battery temperature T1 */
	TEMPERATURE_T2 = <(10)>;
	/* Battery temperature T2 */
	TEMPERATURE_T3 = <(0)>;
	/* Battery temperature T3 */
	TEMPERATURE_T4 = <(-6)>;
	/* Battery temperature T4 */
	TEMPERATURE_T5 = <(-10)>;
	/* Battery temperature T5 */
	g_FG_PSEUDO100_T0 = <(98)>;
	/* Pseudo 100% percentage at T0 */
	g_FG_PSEUDO100_T1 = <(98)>;
	/* Pseudo 100% percentage at T1 */
	g_FG_PSEUDO100_T2 = <(98)>;
	/* Pseudo 100% percentage at T2 */
	g_FG_PSEUDO100_T3 = <(98)>;
	/* Pseudo 100% percentage at T3 */
	g_FG_PSEUDO100_T4 = <(98)>;
	/* Pseudo 100% percentage at T4 */
	Q_MAX_SYS_VOLTAGE_BAT0 = <(3350)>;
	/* Pseudo1 for hide percentage */
	Q_MAX_SYS_VOLTAGE_BAT1 = <(3350)>;
	/* Pseudo1 for hide percentage */
	Q_MAX_SYS_VOLTAGE_BAT2 = <(3350)>;
	/* Pseudo1 for hide percentage */
	Q_MAX_SYS_VOLTAGE_BAT3 = <(3350)>;
	/* Pseudo1 for hide percentage */
	COM_FG_METER_RESISTANCE = <(100)>;
	/* compensate The resistance of PCB */
	COM_R_FG_VALUE = <(0)>;
	/* compensate R_sense resistance */
	enable_tmp_intr_suspend = <(0)>;
	/* Enable update temp when suspend */
	ACTIVE_TABLE = <(0)>;
	/* Table numbers per battery */
	MULTI_BATTERY = <(0)>;
	/* Table numbers per battery */
	MULTI_TEMP_GAUGE0 = <(1)>;
	/* Multi gauge0 enable */
#if defined(CONFIG_WT_PROJECT_T99653AA1) || defined(CONFIG_WT_PROJECT_T99652AA1)
	RBAT_PULL_UP_R = <(160000)>;
#else
	RBAT_PULL_UP_R = <(16900)>;
#endif
	RBAT_PULL_UP_VOLT = <(1800)>;

//+bug 584789, liyiying.wt, mod, 2021/01/26, modify battery MMIGroup message
//+bug 589756, yaocankun, mod, 20201105, merge bat0 curve
#if defined(CONFIG_WT_PROJECT_T99653AA1)
#include "T99653AA1_fenghua_4V4_5050mah.dtsi"
//+bug 584789, liyiying.wt, add, 2020/11/30, add second battery curve
#include "T99653AA1_jiade_4V4_5050mah.dtsi"
//-bug 584789, liyiying.wt, add, 2020/11/30, add second battery curve
//+bug 584789, liyiying.wt, add, 2020/11/06, merge bat1 curve
#elif defined(CONFIG_WT_PROJECT_T99652AA1)
#include "T99652AA1_fenghua_4V4_5050mah.dtsi"
#include "T99652AA1_jiade_4V4_5050mah.dtsi"
//-bug 584789, liyiying.wt, add, 2020/11/06, merge bat1 curve
//-bug 584789, liyiying.wt, mod, 2021/01/26, modify battery MMIGroup message
#else
#include "mt6765_battery_table_ext.dtsi"
#endif
//-bug 589756, yaocankun, mod, 20201105, merge bat0 curve
};
